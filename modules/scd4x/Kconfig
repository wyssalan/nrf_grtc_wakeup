## modules/scd4x/Kconfig
```kconfig
# Drivers configuration options for Sensirion SCD4x

# Copyright (c) 2024 Jan Fäh
# SPDX-License-Identifier: Apache-2.0


menuconfig SCD4X
	bool "SCD4x Carbon Dioxide Sensor"
	default y
	depends on DT_HAS_SENSIRION_SCD41_ENABLED || DT_HAS_SENSIRION_SCD40_ENABLED
	select I2C
	select CRC
if SCD4X

module = SCD4X
module-str = "Sensirion SD4x Driver"
source "subsys/logging/Kconfig.template.log_config"

endif # SCD4X
```
